## boards/shields/corne_oled_animation/Kconfig.shield
```kconfig
config SHIELD_CORNE_OLED_ANIMATION
    def_bool $(shields_list_contains,corne_oled_animation)
    select LVGL
    select ZMK_DISPLAY

config CORNE_OLED_ANIMATION_ENABLED
    bool "Enable Urchin peripheral animation"
    depends on SHIELD_CORNE_OLED_ANIMATION
    default y
```

## boards/shields/corne_oled_image/Kconfig.defconfig
```kconfig
if SHIELD_CORNE_OLED_IMAGE

config LVGL
    default y

config ZMK_DISPLAY
    default y

endif
```

## boards/shields/corne_oled_image/Kconfig.shield
```kconfig
config SHIELD_CORNE_OLED_IMAGE
    def_bool $(shields_list_contains,corne_oled_image)
    select LVGL
    select ZMK_DISPLAY
```

## boards/shields/m00corne/Kconfig.defconfig
```kconfig
if SHIELD_M00CORNE_LEFT

# Name must be less than 16 characters long!
config ZMK_KEYBOARD_NAME
    default "m00corne"

config ZMK_SPLIT_ROLE_CENTRAL
    default y

endif

if SHIELD_M00CORNE_LEFT || SHIELD_M00CORNE_RIGHT

config ZMK_SPLIT
    default y

config ZMK_BACKLIGHT
    default y

config PWM
    default y

config LED_PWM
    default y

endif

if ZMK_BACKLIGHT

config PWM
    default y

config LED_PWM
    default y

endif # ZMK_BACKLIGHT
```

## config/boards/shields/m00corne/Kconfig.defconfig
```kconfig
if SHIELD_M000CORNE

config ZMK_KEYBOARD_NAME
		default "m00corne"

endif

if ZMK_BACKLIGHT

config PWM
    default y

config LED_PWM
    default y

endif # ZMK_BACKLIGHT
```

## config/boards/shields/m00corne/Kconfig.shield
```kconfig
config SHIELD_M00CORNE_LEFT
		def_bool $(shields_list_contains, m00corne_left)

config SHIELD_M00CORNE_RIGHT
		def_bool $(shields_list_contains, m00corne_right)
```

## config/west.yml
```yaml
manifest:
  defaults:
    revision: v0.3
  remotes:
    - name: zmkfirmware
      url-base: https://github.com/zmkfirmware
    - name: joelspadin
      url-base: https://github.com/joelspadin
    - name: urob
      url-base: https://github.com/urob
    - name: mctechnology17
      url-base: https://github.com/mctechnology17
    - name: gpeye
      url-base: https://github.com/GPeye
    # Additional modules containing boards/shields/custom code can be listed here as well
    # See https://docs.zephyrproject.org/3.2.0/develop/west/manifest.html#projects
  projects:
    - name: zmk
      remote: zmkfirmware
      import: app/west.yml
      revision: v0.3.0
    - name: zmk-locales
      remote: joelspadin
      revision: main
    - name: zmk-helpers
      remote: urob
      revision: v0.3.0
    - name: zmk-unicode
      remote: urob
      revision: v0.3.0
    - name: zmk-auto-layer
      remote: urob
      revision: v0.3.0
    - name: zmk-nice-oled
      remote: mctechnology17
      revision: main
    - name: zmk-adaptive-key
      remote: urob
      revision: v0.3 # Should match ZMK release.
    - name: zmk-tri-state
      remote: urob
      revision: v0.3 # Should match ZMK release.
    - name: urchin-peripheral-animation
      remote: gpeye
      revision: main
  self:
    path: config
```

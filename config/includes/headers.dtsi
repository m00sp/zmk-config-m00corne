//	Make sure this file is included to load all the headers
/*
 *		This file contains all the headers. Use it to add all the necessary headers
 */
// Personal headers
#include "definitions.dtsi" // My definitions, must be sourced first
// ZMK headers
#include <dt-bindings/zmk/pointing.h> // ZMK mouse
#include <behaviors.dtsi> // ZMK behaviors
#include <dt-bindings/zmk/keys.h> // ZMK keys
#include <dt-bindings/zmk/bt.h> // ZMK bluetoothw
// Modules headers
#include <locale/keys_pt_abnt2.h> // Joel locales for portuguese
#include <behaviors/num_word.dtsi> // Urob autolayer
#include <behaviors/unicode.dtsi> // Urob unicode
//#include "zmk-helpers/helper.h" // Urob helper macros
#include "zmk-helpers/key-labels/42.h" // Urob key label module
//Personal includes
// Other personal headers
#include "behaviours.dtsi" // My custom behaviours
#include "settings.dtsi" // My custom settings
//#include "combos.dtsi" // Not in use by now
//#include "macros.dtsi" // Not in use by now
